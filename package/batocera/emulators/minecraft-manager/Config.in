## package/batocera/emulators/minecraft-manager/Config.in
```kconfig
config BR2_PACKAGE_MINECRAFT_MANAGER
    bool "minecraft-manager"
    depends on BR2_PACKAGE_QT6
    select BR2_PACKAGE_QT6BASE_GUI
    select BR2_PACKAGE_QT6DECLARATIVE
    select BR2_PACKAGE_QT6DECLARATIVE_QUICK
    select BR2_PACKAGE_QT6IMAGEFORMATS  # Modrinth's icons are mostly WebP
    select BR2_PACKAGE_SDL2
    help
      Manage Minecraft, the Minecraft system's mod manager: browse
      Modrinth, install, update and remove mods for both instances
      (P1 and P2), with a controller. The mod work is done by
      batocera-minecraft-mods from the prismlauncher package.
```

## package/batocera/emulators/prismlauncher/Config.in
```kconfig
config BR2_PACKAGE_PRISMLAUNCHER
    bool "prismlauncher"
    depends on BR2_x86_64
    depends on BR2_PACKAGE_XORG7
    select BR2_PACKAGE_XDOTOOL
    select BR2_PACKAGE_MINECRAFT_MANAGER if BR2_PACKAGE_QT6  # Manage Minecraft
    help
      Prism Launcher, the backend of the Minecraft system.

      Ships the upstream AppImage plus batocera-minecraft, which
      launches Single Player, Split Screen, Manage Minecraft and the
      Prism window, and batocera-minecraft-mods (Modrinth mods for P1
      and P2).

      https://prismlauncher.org
```

## package/batocera/libraries/qt6imageformats/Config.in
```kconfig
config BR2_PACKAGE_QT6IMAGEFORMATS
	bool "qt6imageformats"
	select BR2_PACKAGE_QT6BASE_GUI
	select BR2_PACKAGE_WEBP
	select BR2_PACKAGE_WEBP_DEMUX
	select BR2_PACKAGE_WEBP_MUX
	help
	  Qt Image Formats: extra image format plugins for Qt. Only the
	  WebP plugin is built (Modrinth's icons in Manage Minecraft),
	  against the system libwebp.

	  Batocera's Buildroot (43.1) has no qt6imageformats package; if
	  a later one does, drop this one.

	  https://doc.qt.io/qt-6/qtimageformats-index.html
```
